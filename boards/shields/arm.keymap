#include <behaviors.dtsi>

/ {
    keymap {
        compatible = "zmk,keymap";

        default_layer {
// --------------------------------------------------------------------------------------------------------------------------------------------------------------------
// |   1   |    2    |    3    |    4    |    5    |    6    |
            bindings = <
    &kp N1    &kp N2    &kp N3    &kp N4     &kp N5     &kp N6
            >;
        };
    };
};